## drivers/input/fingerprint/Kconfig
```kconfig
#
#Fingerprint
#
menu "Fingerprint support"
	depends on INPUT

config MTK_FINGERPRINT_SUPPORT
	bool "Mediatek Fingerprint"
	default n
	---help---
	Fingerprint mtk driver enable/disable in the kernel.
	Say Y here if you want to use mediatek fingerprint driver,
	fingerprint driver will support fingerprint function

if MTK_FINGERPRINT_SUPPORT
config MTK_FINGERPRINT_SELECT
	string "sensor type"
	default "ET310"

if MTK_FINGERPRINT_SELECT = "ET310"
config MTK_ET310
        bool "ET310 for MediaTek package"
        default n
endif

config NB_FINGER_CLEAR_SUPPORT
        bool "NB FINGER CLEAR SUPPORT"
        default n
endif
endmenu
```

## drivers/input/touchscreen/mediatek/Kconfig
```kconfig
#
# Touchscreen driver configuration
#
menuconfig INPUT_TOUCHSCREEN
	bool "Touchscreens"
	help
	  Say Y here, and a list of supported touchscreens will be displayed.
	  This option doesn't affect the kernel.

	  If unsure, say Y.

if INPUT_TOUCHSCREEN

config TOUCHSCREEN_MTK
	tristate "MediaTek Touch Panel Driver"
	default n
	help
	  Say Y here if you have MediaTek touch panel.

	  If unsure, say N.

	  To compile this dirver as a module, choose M here: the
	  module will be called.

config TOUCHSCREEN_MTK_GT9XX_HOTKNOT_SCP
	bool "GT9XX_HOTKNOT_SCP for Mediatek package"
	default n
	help
	  Say Y here if you have GT9XX_HOTKNOT_SCP touch panel.

	  If unsure, say N.

	  To compile this dirver as a module, choose M here: the
	  module will be called.

source "drivers/input/touchscreen/mediatek/GT9XX_hotknot_scp/Kconfig"

endif
```

## drivers/misc/mediatek/alsps/Kconfig
```kconfig
config CUSTOM_KERNEL_ALSPS
	bool "CUSTOM_KERNEL_ALSPS"
	help
	  ALSPS sensor driver to detect ambient light and the object is close
	  or far awary from device. After configure this configuration,
          the specific ambient light and proximity sensor driver configuration
          should be configured as well.

config MTK_AUTO_DETECT_ALSPS
	bool "MTK_AUTO_DETECT_ALSPS"
	help
	  This feature Option is used for projects which using more than one
	  ALSPS sensors, more than one ALSPS drivers can be builded in to
	  project and be auto detected by setting this option to yes,
          usually only one ALSPS driver can be probed.

config CUSTOM_KERNEL_ALSPS_MODULE
	bool "Use to control the alsps sensor build type"
	help
	  Use to control the sensor build tpye.
	  If the config is set, it means sensor
	  will build ko module.
	  This is request fromo Google about odm driver.

source "drivers/misc/mediatek/alsps/ap3xx6/Kconfig"
```

## drivers/misc/mediatek/barometer/Kconfig
```kconfig
config CUSTOM_KERNEL_BAROMETER
	bool "CUSTOM_KERNEL_BAROMETER"
	help
	  To detect barometer raw data
```

## drivers/misc/mediatek/gyroscope/Kconfig
```kconfig
config CUSTOM_KERNEL_GYROSCOPE
	bool "CUSTOM_KERNEL_GYROSCOPE"
	help
	  gyroscope sensor to detect gyroscope from x y z axis.
	  If the platform is supported for gyroscope, this
	  configuration should be configured, and the gyroscope
	  driver configuration should be configured as well.

config CUSTOM_KERNEL_GYROSCOPE_MODULE
	bool "Use to control the gyroscope sensor build type"
	help
	  Use to control the sensor build tpye.
	  If the config is set, it means sensor
	  will build ko module.
	  This is request fromo Google about odm driver.

source "drivers/misc/mediatek/gyroscope/lsm6ds0gy/Kconfig"
```

## drivers/misc/mediatek/lens/Kconfig
```kconfig
config MTK_LENS
  bool CONFIG_MTK_LENS
  default n
  help
    CONFIG_MTK_LENS

#
# LENS
#

config MTK_LENS_DUMMYLENS_SUPPORT
  bool "Dummy Lens Driver"
  default n
  help
    Dummy Lens Driver
    This config is used to enable the corresponding
    lens driver for the camera sensor module
    Set as y if the driver is used in this project

config MTK_LENS_BU6424AF_SUPPORT
  bool "BU6424AF Lens Driver"
  default n
  help
    BU6424AF Lens Driver
    This config is used to enable the corresponding
    lens driver for the camera sensor module
    Set as y if the driver is used in this project

config MTK_LENS_DW9714AF_SUPPORT
  bool "DW9714AF Lens Driver"
  default n
  help
    DW9714AF Lens Driver
    This config is used to enable the corresponding
    lens driver for the camera sensor module
    Set as y if the driver is used in this project
```

## drivers/misc/mediatek/magnetometer/Kconfig
```kconfig
config MTK_AUTO_DETECT_MAGNETOMETER
	bool "MTK_AUTO_DETECT_MAGNETOMETER"
	help
	  one load to support different magnetometer sensor.
          This feature Option is used for projects which using more than one
	  magnetometer, more than one ALSPS drivers can be builded in to
	  project and be auto detected by setting this option to yes

config CUSTOM_KERNEL_MAGNETOMETER
	bool "CUSTOM_KERNEL_MAGNETOMETER"
	help
	  compass driver to detect compass raw data and report orientatino
	  data. A compass is an instrument used for navigation and
          orientation that shows direction relative to the geographic
          cardinal directions, or "points".

config CUSTOM_KERNEL_MAGNETOMETER_MODULE
	bool "Use to control the mag sensor build type"
	help
	  Use to control the sensor build tpye.
	  If the config is set, it means sensor
	  will build ko module.
	  This is request fromo Google about odm driver.

source "drivers/misc/mediatek/magnetometer/maghub/Kconfig"
source "drivers/misc/mediatek/magnetometer/mmc3416x/Kconfig"
```
